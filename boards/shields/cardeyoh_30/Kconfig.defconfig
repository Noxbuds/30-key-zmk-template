## boards/shields/cardeyoh_30/Kconfig.defconfig
```kconfig
if SHIELD_CARDEYOH_30_LEFT

    config ZMK_KEYBOARD_NAME
        default "Cardey-oh 30"

    config ZMK_SPLIT_ROLE_CENTRAL
        default y

endif

if SHIELD_CARDEYOH_30_LEFT || SHIELD_CARDEYOH_30_RIGHT
    config ZMK_SPLIT
        default y

endif
```

## boards/shields/cardeyoh_30/Kconfig.shield
```kconfig
config SHIELD_CARDEYOH_30_LEFT
    def_bool $(shields_list_contains,cardeyoh_30_left)

config SHIELD_CARDEYOH_30_RIGHT
    def_bool $(shields_list_contains,cardeyoh_30_right)
```
